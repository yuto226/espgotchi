## sdkconfig.defaults
```kconfig
# ESP32 Tamagotchi Emulator Default Configuration

# Enable SPIFFS
CONFIG_PARTITION_TABLE_CUSTOM=y
CONFIG_PARTITION_TABLE_CUSTOM_FILENAME="partitions.csv"

# USB removed - TinyUSB not compatible

# FreeRTOS Configuration
CONFIG_FREERTOS_HZ=1000

# ESP32 Specific
CONFIG_ESP32_DEFAULT_CPU_FREQ_240=y

# NVS Configuration
CONFIG_NVS_ENCRYPTION=n

# SPIFFS Configuration
CONFIG_SPIFFS_MAX_PARTITIONS=3

# Power Management
CONFIG_PM_ENABLE=y
CONFIG_PM_DFS_INIT_AUTO=y

# ADC Configuration
CONFIG_ADC_CAL_EFUSE_TP_ENABLE=y
CONFIG_ADC_CAL_EFUSE_VREF_ENABLE=y

# SPI Configuration
CONFIG_SPI_MASTER_IN_IRAM=y

# Log levels
CONFIG_LOG_DEFAULT_LEVEL_INFO=y
```
